## conf/layer.conf
```bitbake
# We have a conf and classes directory, append to BBPATH
BBPATH .= ":${LAYERDIR}"

# We have a recipes directory, add to BBFILES
BBFILES += " \
	${LAYERDIR}/recipes*/*/*.bb \
	${LAYERDIR}/recipes*/*/*.bbappend \
	${LAYERDIR}/recipes*/*/*/*.bb \
	${LAYERDIR}/recipes*/*/*/*.bbappend \
"

BBFILE_COLLECTIONS += "meta-ryzen"
BBFILE_PATTERN_meta-ryzen := "^${LAYERDIR}/"
BBFILE_PRIORITY_meta-ryzen = "100"

LAYERSERIES_COMPAT_meta-ryzen = "dunfell gatesgarth hardknott honister"

LAYERDEPENDS_meta-ryzen = "core intel"
```

## conf/machine/amd-zen-64.conf
```bitbake
#@TYPE: Machine
#@NAME: amd-zen2-64

#@DESCRIPTION: AMD Family 17h Zen core based CPUs with x86-64 instruction set support.

DEFAULTTUNE = "zen-64"

require conf/machine/include/tune-zen.inc
require conf/machine/include/corei7-common.inc
```

## conf/machine/amd-zen2-64.conf
```bitbake
#@TYPE: Machine
#@NAME: amd-zen2-64

#@DESCRIPTION: AMD Family 17h Zen 2 core based CPUs with x86-64 instruction set support.

DEFAULTTUNE = "zen2-64"

require conf/machine/include/tune-zen2.inc
require conf/machine/include/corei7-common.inc
```

## conf/machine/amd-zen3-64.conf
```bitbake
#@TYPE: Machine
#@NAME: amd-zen2-64

#@DESCRIPTION: AMD Family 19h Zen 3 core based CPUs with x86-64 instruction set support.

DEFAULTTUNE = "zen3-64"

require conf/machine/include/tune-zen3.inc
require conf/machine/include/corei7-common.inc
```

## conf/machine/include/tune-haswell.inc
```bitbake
# Settings for the GCC(1) cpu-type "znver2":
#
#     Zen 3
#     AMD Family 19h core based CPUs with x86-64 instruction set support.
#
#     Supported instructions:
#
#       BMI, BMI2, CLWB, F16C, FMA, FSGSBASE, AVX, AVX2, ADCX, RDSEED, MWAITX, 
#       SHA, CLZERO, AES, PCLMUL, CX16, MOVBE, MMX, SSE, SSE2, SSE3, SSE4A, 
#       SSSE3, SSE4.1, SSE4.2, ABM, XSAVEC, XSAVES, CLFLUSHOPT, POPCNT, RDPID, 
#       WBNOINVD, PKU, VPCLMULQDQ, VAES
#
#
DEFAULTTUNE ?= "haswell-64"

# Include the previous tune to pull in PACKAGE_EXTRA_ARCHS
require conf/machine/include/tune-corei7.inc

# Extra tune features
TUNEVALID[haswell] = "Enable haswell specific processor optimizations"
TUNE_CCARGS .= "${@bb.utils.contains('TUNE_FEATURES', 'haswell', ' -march=haswell -mtune=haswell -mfpmath=sse', '', d)}"

# Extra tune selections
AVAILTUNES += "haswell-32"
TUNE_FEATURES_tune-haswell-32 = "${TUNE_FEATURES_tune-x86} haswell"
BASE_LIB_tune-haswell-32 = "lib"
TUNE_PKGARCH_tune-haswell-32 = "haswell-32"
PACKAGE_EXTRA_ARCHS_tune-haswell-32 = "${PACKAGE_EXTRA_ARCHS_tune-core2-32} haswell-32"
QEMU_EXTRAOPTIONS_haswell-32 = " -cpu Haswell,check=false"

AVAILTUNES += "haswell-64"
TUNE_FEATURES_tune-haswell-64 = "${TUNE_FEATURES_tune-x86-64} haswell"
BASE_LIB_tune-haswell-64 = "lib64"
TUNE_PKGARCH_tune-haswell-64 = "haswell-64"
PACKAGE_EXTRA_ARCHS_tune-haswell-64 = "${PACKAGE_EXTRA_ARCHS_tune-core2-64} haswell-64"
QEMU_EXTRAOPTIONS_haswell-64 = " -cpu Haswell,check=false"

AVAILTUNES += "haswell-64-x32"
TUNE_FEATURES_tune-haswell-64-x32 = "${TUNE_FEATURES_tune-x86-64-x32} haswell"
BASE_LIB_tune-haswell-64-x32 = "libx32"
TUNE_PKGARCH_tune-haswell-64-x32 = "haswell-64-x32"
PACKAGE_EXTRA_ARCHS_tune-haswell-64-x32 = "${PACKAGE_EXTRA_ARCHS_tune-core2-64-x32} haswell-64-x32"
QEMU_EXTRAOPTIONS_haswell-64-x32 = " -cpu Haswell,check=false"
```

## conf/machine/include/tune-zen.inc
```bitbake
# Settings for the GCC(1) cpu-type "znver2":
#
#     Zen 1
#     AMD Family 17h core based CPUs with x86-64 instruction set support.
#
#     Supported instructions:
#
#       BMI, BMI2, F16C, FMA, FSGSBASE, AVX, AVX2, ADCX, RDSEED, MWAITX, SHA, 
#       CLZERO, AES, PCLMUL, CX16, MOVBE, MMX, SSE, SSE2, SSE3, SSE4A, SSSE3, 
#       SSE4.1, SSE4.2, ABM, XSAVEC, XSAVES, CLFLUSHOPT, POPCNT
#

DEFAULTTUNE ?= "zen-64"

# Include the previous tune to pull in PACKAGE_EXTRA_ARCHS
require conf/machine/include/tune-corei7.inc

# Extra tune features
TUNEVALID[zen] = "Enable zen specific processor optimizations"
TUNE_CCARGS .= "${@bb.utils.contains('TUNE_FEATURES', 'zen', ' -march=znver1 -mfpmath=sse', '', d)}"

# Extra tune selections
AVAILTUNES += "zen-32"
TUNE_FEATURES_tune-zen-32 = "${TUNE_FEATURES_tune-x86} zen"
BASE_LIB_tune-zen-32 = "lib"
TUNE_PKGARCH_tune-zen-32 = "zen-32"
PACKAGE_EXTRA_ARCHS_tune-zen-32 = "${PACKAGE_EXTRA_ARCHS_tune-core2-32} zen-32"
#QEMU_EXTRAOPTIONS_zen-32 = " -cpu ,check=false"

AVAILTUNES += "zen-64"
TUNE_FEATURES_tune-zen-64 = "${TUNE_FEATURES_tune-x86-64} zen"
BASE_LIB_tune-zen-64 = "lib64"
TUNE_PKGARCH_tune-zen-64 = "zen-64"
PACKAGE_EXTRA_ARCHS_tune-zen-64 = "${PACKAGE_EXTRA_ARCHS_tune-core2-64} zen-64"
#QEMU_EXTRAOPTIONS_zen-64 = " -cpu ,check=false"

AVAILTUNES += "zen-64-x32"
TUNE_FEATURES_tune-zen-64-x32 = "${TUNE_FEATURES_tune-x86-64-x32} zen"
BASE_LIB_tune-zen-64-x32 = "libx32"
TUNE_PKGARCH_tune-zen-64-x32 = "zen-64-x32"
PACKAGE_EXTRA_ARCHS_tune-zen-64-x32 = "${PACKAGE_EXTRA_ARCHS_tune-core2-64-x32} zen-64-x32"
#QEMU_EXTRAOPTIONS_zen-64-x32 = " -cpu ,check=false"
```

## conf/machine/include/tune-zen2.inc
```bitbake
# Settings for the GCC(1) cpu-type "znver2":
#
#     Zen 2
#     AMD Family 17h core based CPUs with x86-64 instruction set support.
#
#     Supported instructions:
#
#       BMI, BMI2, CLWB, F16C, FMA, FSGSBASE, AVX, AVX2, ADCX, RDSEED, MWAITX, 
#       SHA, CLZERO, AES, PCLMUL, CX16, MOVBE, MMX, SSE, SSE2, SSE3, SSE4A, SSSE3, 
#       SSE4.1, SSE4.2, ABM, XSAVEC, XSAVES, CLFLUSHOPT, POPCNT, RDPID, WBNOINVD
#
#
DEFAULTTUNE ?= "zen2-64"

# Include the previous tune to pull in PACKAGE_EXTRA_ARCHS
require conf/machine/include/tune-corei7.inc

# Extra tune features
TUNEVALID[zen2] = "Enable zen2 specific processor optimizations"
TUNE_CCARGS .= "${@bb.utils.contains('TUNE_FEATURES', 'zen2', ' -march=znver2 -mfpmath=sse -msse4.2', '', d)}"

# Extra tune selections
AVAILTUNES += "zen2-32"
TUNE_FEATURES_tune-zen2-32 = "${TUNE_FEATURES_tune-x86} zen2"
BASE_LIB_tune-zen2-32 = "lib"
TUNE_PKGARCH_tune-zen2-32 = "zen2-32"
PACKAGE_EXTRA_ARCHS_tune-zen2-32 = "${PACKAGE_EXTRA_ARCHS_tune-core2-32} zen2-32"
QEMU_EXTRAOPTIONS_zen2-32 = " -cpu Haswell,check=false"

AVAILTUNES += "zen2-64"
TUNE_FEATURES_tune-zen2-64 = "${TUNE_FEATURES_tune-x86-64} zen2"
BASE_LIB_tune-zen2-64 = "lib64"
TUNE_PKGARCH_tune-zen2-64 = "zen2-64"
PACKAGE_EXTRA_ARCHS_tune-zen2-64 = "${PACKAGE_EXTRA_ARCHS_tune-core2-64} zen2-64"
QEMU_EXTRAOPTIONS_zen2-64 = " -cpu Haswell,check=false"

AVAILTUNES += "zen2-64-x32"
TUNE_FEATURES_tune-zen2-64-x32 = "${TUNE_FEATURES_tune-x86-64-x32} zen2"
BASE_LIB_tune-zen2-64-x32 = "libx32"
TUNE_PKGARCH_tune-zen2-64-x32 = "zen2-64-x32"
PACKAGE_EXTRA_ARCHS_tune-zen2-64-x32 = "${PACKAGE_EXTRA_ARCHS_tune-core2-64-x32} zen2-64-x32"
QEMU_EXTRAOPTIONS_zen2-64-x32 = " -cpu Haswell,check=false"
```

## conf/machine/include/tune-zen3.inc
```bitbake
# Settings for the GCC(1) cpu-type "znver2":
#
#     Zen 3
#     AMD Family 19h core based CPUs with x86-64 instruction set support.
#
#     Supported instructions:
#
#       BMI, BMI2, CLWB, F16C, FMA, FSGSBASE, AVX, AVX2, ADCX, RDSEED, MWAITX, 
#       SHA, CLZERO, AES, PCLMUL, CX16, MOVBE, MMX, SSE, SSE2, SSE3, SSE4A, 
#       SSSE3, SSE4.1, SSE4.2, ABM, XSAVEC, XSAVES, CLFLUSHOPT, POPCNT, RDPID, 
#       WBNOINVD, PKU, VPCLMULQDQ, VAES
#
#
DEFAULTTUNE ?= "zen3-64"

# Include the previous tune to pull in PACKAGE_EXTRA_ARCHS
require conf/machine/include/tune-corei7.inc

# Extra tune features
TUNEVALID[zen3] = "Enable zen3 specific processor optimizations"
TUNE_CCARGS .= "${@bb.utils.contains('TUNE_FEATURES', 'zen3', ' -march=znver2 -mfpmath=sse', '', d)}"

# Extra tune selections
AVAILTUNES += "zen3-32"
TUNE_FEATURES_tune-zen3-32 = "${TUNE_FEATURES_tune-x86} zen3"
BASE_LIB_tune-zen3-32 = "lib"
TUNE_PKGARCH_tune-zen3-32 = "zen3-32"
PACKAGE_EXTRA_ARCHS_tune-zen3-32 = "${PACKAGE_EXTRA_ARCHS_tune-core2-32} zen3-32"
#QEMU_EXTRAOPTIONS_zen3-32 = " -cpu ,check=false"

AVAILTUNES += "zen3-64"
TUNE_FEATURES_tune-zen3-64 = "${TUNE_FEATURES_tune-x86-64} zen3"
BASE_LIB_tune-zen3-64 = "lib64"
TUNE_PKGARCH_tune-zen3-64 = "zen3-64"
PACKAGE_EXTRA_ARCHS_tune-zen3-64 = "${PACKAGE_EXTRA_ARCHS_tune-core2-64} zen3-64"
#QEMU_EXTRAOPTIONS_zen3-64 = " -cpu ,check=false"

AVAILTUNES += "zen3-64-x32"
TUNE_FEATURES_tune-zen3-64-x32 = "${TUNE_FEATURES_tune-x86-64-x32} zen3"
BASE_LIB_tune-zen3-64-x32 = "libx32"
TUNE_PKGARCH_tune-zen3-64-x32 = "zen3-64-x32"
PACKAGE_EXTRA_ARCHS_tune-zen3-64-x32 = "${PACKAGE_EXTRA_ARCHS_tune-core2-64-x32} zen3-64-x32"
#QEMU_EXTRAOPTIONS_zen3-64-x32 = " -cpu ,check=false"
```

## conf/machine/intel-haswell.conf
```bitbake
#@TYPE: Machine
#@NAME: Intel Haswell

#@DESCRIPTION: Intel Haswell

DEFAULTTUNE = "haswell-64"

require conf/machine/include/tune-haswell.inc
require conf/machine/include/corei7-common.inc
```
